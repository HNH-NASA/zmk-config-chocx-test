## config/boards/shields/ChocX/Kconfig.defconfig
```kconfig
if SHIELD_CHOCX_R

config ZMK_KEYBOARD_NAME
    default "ChocX_R"

config ZMK_SPLIT
    default y

config ZMK_SPLIT_ROLE_CENTRAL
    default y

config ZMK_POINTING
    default y

config AZ1UBALL
    default y

config I2C
    default y

endif


if SHIELD_CHOCX_L

config ZMK_SPLIT
    default y

config ZMK_SPLIT
    default y

endif


if ZMK_BACKLIGHT

config PWM
    default y

config LED_PWM
    default y

endif # ZMK_BACKLIGHT
```
